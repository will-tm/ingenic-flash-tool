## embedded/package/ingenic-flash/Config.in
```kconfig
config BR2_PACKAGE_INGENIC_FLASH
	bool "ingenic-flash"
	select BR2_PACKAGE_LIBUSB
	help
	  Compact USB-boot flasher for Ingenic T33ZN (T-series) SoCs.
	  Flashes SPI NOR over the Ingenic USB boot protocol. Board
	  firmware (SPL/U-Boot) and the SPI-NOR config are embedded at
	  build time via firmware_blob.h.

	  https://github.com/your-org/ingenic-flash-tool
```
